## Kconfig
```kconfig
# モジュールのメインKconfig
config ADNS5050
    bool "ADNS5050 optical mouse sensor support"
    default y
    depends on DT_HAS_PIXART_ADNS5050_ENABLED
    help
      Enable support for ADNS5050 optical mouse sensor module.

if ADNS5050
rsource "drivers/sensor/adns5050/Kconfig"
endif # ADNS5050
```

## drivers/sensor/adns5050/Kconfig
```kconfig
# Copyright (c) 2024 Your Name
# SPDX-License-Identifier: MIT

config INPUT_ADNS5050
    bool "ADNS5050 optical mouse sensor"
    default y
    depends on DT_HAS_PIXART_ADNS5050_ENABLED
    depends on SPI
    depends on INPUT
    help
      Enable driver for Pixart ADNS5050 optical mouse sensor.
      This sensor provides configurable CPI resolution from 125 to 1375
      and communicates via 3-wire SPI interface.

if INPUT_ADNS5050

module = ADNS5050
module-str = adns5050
source "subsys/logging/Kconfig.template.log_config"

endif # INPUT_ADNS5050
```

## dts/bindings/pixart,adns5050.yml
```yaml
description: |
  Sensor driver for the ADNS5050 optical mouse sensor
  Uses GPIO bit-banging communication (no SPI required)
  Uses polling-based operation (no IRQ pin required)

compatible: "pixart,adns5050"

properties:
  sclk-gpios:
    type: phandle-array
    required: true
    description: Serial clock GPIO pin

  sdio-gpios:
    type: phandle-array
    required: true
    description: Serial data I/O GPIO pin

  cs-gpios:
    type: phandle-array
    required: true
    description: Chip select GPIO pin

  scroll-layers:
    type: array
    default: []
    description: Layers where trackball acts as scroll wheel

  snipe-layers:
    type: array
    default: []
    description: Layers where trackball has reduced sensitivity

  automouse-layer:
    type: int
    default: -1
    description: Layer to activate automatically on mouse movement
```

## dts/bindings/sensor/pixart,adns5050.yml
```yaml
# Copyright (c) 2024 Your Name
# SPDX-License-Identifier: MIT

description: Pixart ADNS5050 optical mouse sensor

compatible: "pixart,adns5050"

include: [spi-device.yaml, mouse.yaml]

properties:
  motion-gpios:
    type: phandle-array
    description: |
      GPIO connected to the MOTION pin of the ADNS5050.
      This pin is used to detect when motion data is available.

  reset-gpios:
    type: phandle-array
    description: |
      GPIO connected to the RESET pin of the ADNS5050.
      This pin is used to perform hardware reset of the sensor.

  cpi:
    type: int
    default: 500
    enum:
      - 125
      - 250
      - 375
      - 500
      - 625
      - 750
      - 875
      - 1000
      - 1125
      - 1250
      - 1375
    description: |
      CPI (Counts Per Inch) resolution.
      ADNS5050 supports configurable resolution from 125 to 1375 CPI
      in 125 CPI steps. Default is 500 CPI.

  invert-x:
    type: boolean
    description: |
      Invert X axis movement direction.

  invert-y:
    type: boolean
    description: |
      Invert Y axis movement direction.
```
